// Copyright 2021 Manna Harbour
// https://github.com/manna-harbour/miryoku

// Chocofi keyboard configuration using Microdox layout mapping
// 36-key split keyboard similar to Microdox

#define MIRYOKU_KLUDGE_THUMBCOMBOS

#include "../miryoku/custom_config.h"
#include "../miryoku/mapping/36/minidox.h"
#include "../miryoku/miryoku.dtsi"